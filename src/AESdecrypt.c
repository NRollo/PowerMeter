#include <stdio.h>
#include <string.h>
#include "mbedtls/gcm.h"
#include "esp_log.h"
#include "mbusparser.h"

static const char *TAG = "DE-CRYPT";

//extern int mbusParseFrame(unsigned char *vframe, int vframeLen );
extern int PublishMqtt(struct MeterData md);

/*
// Encrypted test message
unsigned char cipher_text[] = {0x7E, 0xA1, 0xE9, 0x41, 0x03, 0x13, 0xC6, 0x37, 0xE6, 0xE7, 0x00, 0xDB, 0x08, 0x4B, 0x41, 0x4D, 0x45, 0x01, 0xA4, 0xDC, 0x52, 0x82, 0x01, 0xD0, 0x30, 0x00, 0x07, 0x88, 0xE1, 0xA0, 0x39, 0xB2, 0xD1, 0x4C, 0x71, 0x2D, 0xD4, 0xD8, 0xC8, 0x44, 0x0D, 0x53, 0x68,
                               0xE4, 0x33, 0xBD, 0x70, 0xB7, 0x36, 0x81, 0xE9, 0xA9, 0xEF, 0xFE, 0x38, 0xF1, 0x75, 0xA3, 0x7D, 0xE9, 0xCD, 0xE6, 0x4E, 0x8F, 0x78, 0x0D, 0x8F, 0x18, 0xB4, 0x3F, 0xC0, 0x59, 0xD8, 0x79, 0x02,
                               0xF3, 0xD7, 0x47, 0xB8, 0x14, 0xBC, 0xD0, 0x6A, 0x47, 0x00, 0x68, 0x78, 0x01, 0xBD, 0x5D, 0x06, 0x61, 0x20, 0x54, 0x50, 0x7D, 0x44, 0xE7, 0x66, 0x98, 0xCC, 0x3E, 0x35, 0xCC, 0x9D, 0xE6, 0x2C,
                               0x28, 0x4C, 0x0D, 0xEE, 0xA6, 0x35, 0xB9, 0xBF, 0xC5, 0x6C, 0xE1, 0xFE, 0x5A, 0x3A, 0x1E, 0x5E, 0x27, 0x0B, 0x0C, 0x18, 0x1A, 0xCF, 0x02, 0x15, 0x1F, 0xCC, 0x59, 0x21, 0x34, 0xD0, 0x4F, 0x02,
                               0x92, 0xB5, 0xA3, 0x53, 0x38, 0xD7, 0xB7, 0x81, 0xBB, 0x1F, 0x2A, 0x7E, 0x40, 0x71, 0x81, 0x5C, 0xEE, 0xD5, 0xD4, 0xBA, 0xC6, 0xEF, 0xAA, 0xAF, 0xF9, 0x79, 0xEF, 0x96, 0x9D, 0x0D, 0xB4, 0x6F,
                               0x51, 0xE5, 0xE0, 0xFC, 0x00, 0xF5, 0xAD, 0x10, 0x5F, 0xBE, 0xF9, 0x5F, 0xC5, 0xF8, 0x85, 0x46, 0x0B, 0x56, 0x32, 0x55, 0x4A, 0xC0, 0x5D, 0x9E, 0xB4, 0xF6, 0x5F, 0xF2, 0x23, 0x97, 0x2A, 0x47,
                               0xCF, 0xD4, 0x34, 0xB5, 0xF5, 0xE2, 0xD8, 0x53, 0xEA, 0x4C, 0x14, 0x72, 0x75, 0x86, 0xF0, 0xE2, 0x1C, 0x6E, 0xE1, 0x25, 0x26, 0x8C, 0xB4, 0xDC, 0x7E, 0xC5, 0xB1, 0x0F, 0x84, 0x83, 0xC0, 0x10,
                               0xC8, 0xE6, 0x88, 0xDF, 0x86, 0x58, 0x4D, 0x7C, 0x29, 0xD8, 0x17, 0x31, 0xA4, 0xE0, 0x96, 0x91, 0x41, 0xB6, 0xAD, 0xD9, 0x42, 0xE4, 0x0A, 0x96, 0xE3, 0xE2, 0xDC, 0x2F, 0x90, 0x20, 0xBF, 0x9D,
                               0x58, 0x02, 0xA1, 0x8D, 0xC9, 0x85, 0xBB, 0x54, 0x22, 0xF4, 0x70, 0xC0, 0x62, 0x9D, 0x22, 0xDB, 0x6F, 0x16, 0xB6, 0x64, 0x7D, 0xB3, 0xC9, 0xF7, 0x27, 0xC1, 0x70, 0xC2, 0xDB, 0x4C, 0x9A, 0x23,
                               0x0F, 0x82, 0x83, 0x46, 0xE8, 0x6F, 0x56, 0xD3, 0x47, 0xB6, 0x2B, 0xFE, 0x28, 0xA5, 0x07, 0xAE, 0x2A, 0x21, 0x9A, 0xCC, 0x63, 0xAD, 0x5E, 0xE0, 0x6E, 0xCB, 0x94, 0x9D, 0xC4, 0xFD, 0xC2, 0xD2,
                               0xF8, 0x08, 0x02, 0x7A, 0x4A, 0x4C, 0x67, 0x7C, 0x93, 0xC4, 0xC8, 0x90, 0x9D, 0x73, 0x36, 0xD8, 0xB8, 0xB3, 0x79, 0x18, 0x36, 0xC5, 0x55, 0x5E, 0x74, 0xE2, 0x54, 0x82, 0xA4, 0x4A, 0x5F, 0x6D,
                               0x35, 0x8D, 0xCE, 0x84, 0x50, 0x47, 0x8F, 0x8B, 0x2C, 0x5D, 0x56, 0x66, 0xC2, 0xCF, 0x8B, 0xD1, 0x90, 0xD4, 0x87, 0x4E, 0x70, 0x7F, 0x5D, 0x4B, 0xCD, 0xE9, 0x4E, 0x91, 0x35, 0x5A, 0x81, 0x39,
                               0xC3, 0xE4, 0x1C, 0xD5, 0xF0, 0x88, 0x99, 0xB6, 0x5E, 0xE9, 0xB5, 0x9F, 0xC6, 0x03, 0x72, 0xE4, 0xF9, 0x2B, 0xC9, 0x98, 0x26, 0xB8, 0xC1, 0x47, 0xF2, 0x09, 0x5F, 0xB3, 0x8A, 0x89, 0x14, 0x09,
                               0xAA, 0x81, 0xE2, 0x27, 0x07, 0x6C, 0x21, 0xCB, 0x7C, 0xAF, 0x73, 0xB3, 0xE8, 0xA4, 0xE2, 0x56, 0xC7, 0x0D, 0x95, 0x47, 0xA9, 0x14, 0xF3, 0x9C, 0x16, 0x93, 0x76, 0xBF, 0x92, 0x2B, 0x08, 0x06,
                               0x4E, 0xC4, 0xFB, 0x31, 0xD4, 0x4E, 0xCD, 0x72, 0x1D, 0x1A, 0x15, 0x1E, 0x4E, 0x68, 0x4F, 0x0B, 0x26, 0x85, 0xC4, 0xB6, 0x9D, 0x96, 0xF5, 0xFB, 0x52, 0xD0, 0xB8, 0x12, 0x79, 0x36, 0x24, 0x7E};
int cipher_textLen = sizeof(cipher_text);
*/

// Test keys for above mbus test message
//const unsigned char key[] = {0x5A, 0xD8, 0x41, 0x21, 0xD9, 0xD2, 0x0B, 0x36, 0x4B, 0x7A, 0x11, 0xF3, 0xC1, 0xB5, 0x82, 0x7F};
//const unsigned char aut_key[] = {0xAF, 0xB3, 0xF9, 0x3E, 0x3E, 0x72, 0x04, 0xED, 0xB3, 0xC2, 0x7F, 0x96, 0xDB, 0xD5, 0x1A, 0xE0};

// Insert your decryption keys here (In Denmark the ones from e.g. Radius), see test keys above
const unsigned char key[] = {/* YOUR DECRYPTION KEY */};
const unsigned char aut_key[] = {/* YOUR AUTHENTICATION KEY */};

static const size_t headerSize = 11;
static const size_t footerSize = 3;

int KamDecrypt(unsigned char *cipher_text, int cipher_textLen) {
//int KamDecrypt() {
    int cipherlen = (cipher_textLen - headerSize - footerSize - 18 - 12);
    unsigned char *cipher = (unsigned char*) malloc(cipherlen);
    unsigned char system_title[8];
    unsigned char initial_value[12];
    unsigned char *output = (unsigned char*) malloc(cipherlen);
    unsigned char aut_tag[12];
    unsigned char add_aut_data[17];
    int err1 = 0, err2 = 0, res = 0;

    memset(cipher, 0, cipherlen);
    memset(output, 0, cipherlen);

    // System title
    memcpy(system_title, cipher_text + headerSize + 2, 8);
    // Initial value (IV)
    memcpy(initial_value, system_title, 8);
    memcpy(initial_value + 8, cipher_text + headerSize + 14, 4);
    // Authentication tag
    memcpy(aut_tag, cipher_text + headerSize + cipher_textLen - headerSize - footerSize - 12, 12);
    // Cipher text
    memcpy(cipher, cipher_text + headerSize + 18, cipherlen);
    // Additional Authenticated Data
    memcpy(add_aut_data, cipher_text + headerSize + 13, 1);
    memcpy(add_aut_data + 1, aut_key, sizeof(aut_key));

    // De-crypt
    mbedtls_gcm_context ctx;
    mbedtls_gcm_init(&ctx);
    if ((err1 = mbedtls_gcm_setkey(&ctx, MBEDTLS_CIPHER_ID_AES, key, 128)) == 0) {
        if ((err2 = mbedtls_gcm_auth_decrypt(&ctx, cipherlen, initial_value, 12, add_aut_data, sizeof(add_aut_data), aut_tag, 12, cipher, output)) != 0) {
            ESP_LOGE(TAG, "mbedtls_gcm_auth_decrypt failed errno: %d", err2);
            res = err2;
        }
    }
    else {
        ESP_LOGE(TAG, "mbedtls_gcm_setkey failed errno: %d", err1);
        res = err1;
    }
    mbedtls_gcm_free(&ctx);

    // Parse the de-crypted frame
    if (res == 0) {
        memcpy(cipher_text + headerSize + 18, output, cipherlen);
        //mbusParseFrame(cipher_text, cipher_textLen);
        struct MeterData md = parseMbusFrame(cipher_text, cipher_textLen);
        // Publish to the Mqtt server
        PublishMqtt(md);
    }
    free(cipher);
    free(output);

    //ESP_LOG_BUFFER_HEXDUMP(TAG, cipher_text, cipher_textLen, ESP_LOG_INFO);
    return res;
}